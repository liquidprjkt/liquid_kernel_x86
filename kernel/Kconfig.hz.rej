## kernel/Kconfig.hz.rej
```kconfig
--- kernel/Kconfig.hz
+++ kernel/Kconfig.hz
@@ -5,7 +5,7 @@
 
 choice
 	prompt "Timer frequency"
-	default HZ_250
+	default HZ_625
 	help
 	 Allows the configuration of the timer frequency. It is customary
 	 to have the timer interrupt run at 1000 Hz but 100 Hz may be more
@@ -40,6 +40,13 @@ choice
 	 on SMP and NUMA systems and exactly dividing by both PAL and
 	 NTSC frame rates for video and multimedia work.
 
+	config HZ_625
+		bool "625 HZ"
+	help
+	 The default HZ for ECHO is 625HZ - ticks every 1.6ms.
+	 No need to increase it since the HighRes clock handles
+	 the task preemption in 105us max.
+
 	config HZ_1000
 		bool "1000 HZ"
 	help
@@ -53,6 +60,7 @@ config HZ
 	default 100 if HZ_100
 	default 250 if HZ_250
 	default 300 if HZ_300
+	default 625 if HZ_625
 	default 1000 if HZ_1000
 
 config SCHED_HRTICK
```
